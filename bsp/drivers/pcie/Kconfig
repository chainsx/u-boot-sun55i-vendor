## bsp/drivers/pcie/Kconfig
```kconfig
# SPDX-License-Identifier: GPL-2.0
#
# PCI Endpoint Support
#

config PCIE_ALLWINNER_EP
	bool "Allwinner PCIe endpoint controller"
	default n
	depends on PCI_ENDPOINT
	help
	  Say Y here if you want to support the Allwinner PCIe controller in
	  endpoint mode. This PCIe controller may be embedded into many
	  different vendors SoCs.
```

## bsp/drivers/phy/Kconfig
```kconfig
# SPDX-License-Identifier: GPL-2.0
#
# PCIe PHY Support
#

config AW_INNO_COMBOPHY
	bool "Allwinner Snps PCIe PHY Driver"
	default n
	depends on PHY
	help
	  Support for Allwinner PCIe PHY with Synopsys IP block.
	  It could support PCIe Gen2 single root complex.
```

## bsp/drivers/pinctrl/Kconfig
```kconfig
# SPDX-License-Identifier: GPL-2.0-only

config AW_PINCTRL
	bool  "Pinctrl Support for Allwinner SoCs"
	depends on ARCH_SUNXI
	default y
	help
	  This selects support for the pinctrl on
	  Allwinner sunxi SoCs.

menu "Allwinner Pinctrl Version"
	depends on AW_PINCTRL
choice
	prompt "allwinner pinctrl ip version"
	default AW_PINCTRL_V1

config AW_PINCTRL_V1
	bool "sunxi pinctrl v1"

config AW_PINCTRL_V3
	bool "sunxi pinctrl v3"
	select AW_GPIO_V3

endchoice
endmenu
```

## bsp/drivers/pwm/Kconfig
```kconfig
config AW_PWM
	bool "Enable support for the Allwinner Sunxi PWM"
	depends on DM_PWM
	help
	  This PWM is found on H3, A64 and other Allwinner SoCs. It supports a
	  programmable period and duty cycle. A 16-bit counter is used.
```

## bsp/drivers/remoteproc/Kconfig
```kconfig
config AW_REMOTEPROC
	bool "SUNXI remoteproc driver"
	depends on DM
	select REMOTEPROC
	default n
	help
	  Support for SUNXI remoteproc.

if AW_REMOTEPROC

config AW_RPROC_MISC_OPS
	depends on AW_REMOTEPROC
	bool "Sunxi remoteproc misc ops support"

config AW_RPROC_RSC_HELPER
	depends on AW_REMOTEPROC
	bool "Sunxi remoteproc rsc helper support"

config AW_RPROC_USER_RESOURCE
	select AW_RPROC_MISC_OPS
	depends on AW_RPROC_RSC_HELPER
	bool "Sunxi remoteproc user resource handle support"

endif
```

## bsp/drivers/sound/Kconfig
```kconfig
config SOUND_SUNXI
	bool "Sound support for Allwinner SoCs"
	depends on SOUND && ARCH_SUNXI
	default y
	help
	  This enables support for audio driver API on Allwinner
	  SoCs.

if SOUND_SUNXI

config SOUND_SUNXI_SOC_RWFUNC
	bool

config SOUND_SUNXI_SOC_AUDIOCODEC
	bool

config SOUND_SUNXI_SOC_SOUND
	bool

config SOUND_SUNXI_SUN55IW6_CODEC
	bool "Support sunxi sun55iw6 audio codec"
	depends on MACH_SUN55IW6
	select SOUND_SUNXI_SOC_RWFUNC
	select SOUND_SUNXI_SOC_AUDIOCODEC
	select SOUND_SUNXI_SOC_SOUND
	help
	  Select Y or M to add support for the Codec embedded in the Allwinner
	  SUN55IW6 and affiliated SoCs.

config SOUND_SUNXI_BOOT_TONE
	bool "Enable boot tone"
	depends on SOUND_SUNXI_SUN55IW6_CODEC
	help
	  Select Y or M to add support for Boottone. it depends on Codec
	  embedded in Allwinner SoCs.

endif # SOUND_SUNXI
```

## bsp/drivers/spi/Kconfig
```kconfig
config AW_SPI
	bool "SUNXI SPI driver"
	depends on SPI
	default n
	select HEXDUMP
	help
	  Support for SUNXI SPI controller.
```

## bsp/drivers/twi/Kconfig
```kconfig
config AW_TWI
	bool "SUNXI TWI driver"
	depends on I2C
	help
	  Support for SUNXI TWI controller.
```

## bsp/drivers/usb/Kconfig
```kconfig
menuconfig AW_USB
	bool "Sunxi usb divice support"

if AW_USB

config AW_BURN
	bool "Support sunxi uburn devices"
	select AW_FLASH
	help
	  ENable support for sunxi uburn devices.

menuconfig AW_FASTBOOT
    bool "Support sunxi fastboot devices"
    select AW_FLASH
    select SUNXI_SPRITE
    imply  SUNXI_FASTBOOT_MBR
    imply  SUNXI_FASTBOOT_BOOT0
    imply  SUNXI_FASTBOOT_UBOOT
    help
      ENable support for sunxi fastboot devices.
if AW_FASTBOOT

config SUNXI_FASTBOOT_MBR
    bool "Burn MBR via fastboot"
    help
        Support use fastboot to burn MBR

config SUNXI_FASTBOOT_BOOT0
    bool "Burn boot0/toc0 via fastboot"
    help
        Support use fastboot to burn boot0/toc0

config SUNXI_FASTBOOT_UBOOT
    bool "Burn uboot0/toc1 via fastboot"
    help
        Support use fastboot to burn uboot/toc1

config FASTBOOT_TRANSFER_BUF_OFFSET
	hex "Define fastboot transfer buffer addr offset"
	default 0x41000000
	help
		The fastboot load img addr offset

endif

source bsp/drivers/usb/udc/Kconfig
source bsp/drivers/usb/host/Kconfig

endif
```

## bsp/drivers/usb/host/Kconfig
```kconfig
comment "SUNXI USB Host Controller Drivers"

if USB_EHCI_HCD

config USB_EHCI_HCD_SUNXI
	bool "Allwinner EHCI HCD"
	---help---
	  This driver enables support for the internal USB Host Controllers
	  found in Allwinner SoCs. The controllers are EHCI compliant.

endif
```

## bsp/drivers/usb/udc/Kconfig
```kconfig
menuconfig AW_UDC
	bool "SUNXI UDC driver support"
	default n

if AW_UDC

config AW_UDC_CONTROLLER
	bool "SUNXI UDC controller driver"
	default n
	depends on DM_USB_GADGET
	select USB_GADGET_DUALSPEED
	help
	  Support for SUNXI UDC controller.

config AW_USB_PHY
	default n
	bool "SUNXI USB PHY driver"
	select DM_REGULATOR
	select PHY
	help
	  Support for SUNXI USB PHY controller.

config INITIAL_USB_SCAN_DELAY
	int "Delay initial USB scan by x ms to allow builtin devices to init"
	depends on AW_USB_PHY
	default 0
	help
	  Some boards have on board usb devices which need longer than
	  the USB spec's 1 second to connect from board powerup. Set
	  this option to a nonzero value to add an extra delay before
	  the first USB bus scan.

endif
```

## bsp/drivers/video/Kconfig
```kconfig
#
# Video drivers selection for sunxi soc. These configs only impact the
# compile process. You can surely check all the options. In this case, all the
# display driver will be compiled, but which drivers finally  will be used is
# decided by device tree configuration. What's more, enable needed power for
# display by configure the device tree, and the vop driver will do the rest.
#
# Author: zhengxiaobin <zhengxiaobin@allwinnertech.com>
#

menu "SUNXI LOGO DISPLAY"
config CMD_SUNXI_BMP
	bool "Sunxi Bmp display interface"
	depends on (BOOT_GUI && AW_FLASH && CMD_FAT)
	default n
	---help---
	  Load bmp from flash and display

config SUNXI_SPINOR_BMP
	bool "Bmp read interface for spinor"
	depends on (AW_FLASH)
	default n
	---help---
	  Bmp read interface for spinor.Load bmp from spino into memory

config ENABLE_ADVERT_PICTURE
	bool "Change bmp logo dynamic for advert"
	depends on (CMD_SUNXI_BMP)
	default n
	---help---
	  Change bmp logo dynamic for advert

config SUNXI_SPINOR_JPEG
	bool "jpeg read interface for spinor"
	depends on (AW_FLASH)
	default n
	---help---
	  jpeg read interface for spinor.Load jpeg from spino into memory

config CMD_SUNXI_JPEG
	bool "Sunxi JPEG display interface"
	depends on (AW_FLASH)
	default y if SUNXI_SPINOR_JPEG
	---help---
	  Load bmp from flash and display
endmenu

menu "Direct Rendering Manager"
config AW_DRM
	tristate "DRM Support for Allwinner SoCs"
	depends on DM
	select CMD_BMP
	select VIDEO
	select DISPLAY
	select CLK
	select MISC
	select DM_REGULATOR
	select VIDEO_BRIDGE
	select BMP_16BPP
	select BMP_24BPP
	select BMP_32BPP
	default n
	---help---
	  DRM Support for Allwinner SoCs

config AW_DRM_DE
	bool "Support Sunxi Display_Engine(DE)"
	depends on AW_DRM
	default y
	help
		If you want use DE of Version 35X, select it.

config AW_DRM_TCON
	bool "Support Timing Controller(TCON)"
	depends on AW_DRM
	default y
	help
		If you want use TCON, select it.

config AW_DRM_TCON_TOP
	bool "Support TCON TOP"
	depends on AW_DRM
	default y
	help
		If you want use TCON TOP, select it.

config AW_DRM_LVDS
	bool "Support LVDS Output"
	depends on AW_DRM
	select AW_DRM_DSI_COMBOPHY
	default n
	help
		If you want use lvds, select it.

config AW_DRM_RGB
	bool "Support RGB Output"
	depends on AW_DRM
	default n
	help
		If you want use rgb, select it.

config AW_DRM_DSI
	bool "Support DSI Output"
	depends on AW_DRM
	select AW_DRM_DSI_COMBOPHY
	select MIPI_DPHY_HELPERS
	default n
	help
		If you want lcd-dsi output for drm driver, select it.

menuconfig AW_DRM_HDMI_TX
	tristate "Support Hdmi Output"
	depends on AW_DRM
	default y
	help
		If you want hdmi output for drm driver, select it.

menuconfig AW_DRM_HDMI14
	bool "Support HDMI1.4 Output"
	depends on AW_DRM_HDMI_TX
	default n
	help
		If you want hdmi1.4 output for drm driver, select it.

menuconfig AW_DRM_HDMI20
	bool "Support HDMI2.0 Output"
	depends on AW_DRM_HDMI_TX
	default y
	help
		If you want hdmi2.0 output for drm driver, select it.

config AW_HDMI20_HDCP14
	bool "HDMI2.0 HDCP1.4"
	depends on (AW_DRM_HDMI20)
	default n
	help
		Say Y here if you want to enable hdcp1.4 function.
		Say N here if you want to disable hdcp1.4 function.
		If unsure, say N.

config AW_HDMI20_HDCP22
	bool "HDMI2.0 HDCP2.2"
	depends on (AW_DRM_HDMI20)
	default n
	help
		Say Y here if you want to enable hdcp2.2 function.
		Say N here if you want to disable hdcp2.2 function.
		If unsure, say N.

config AW_HDMI20_CEC
	bool "HDMI2.0 CEC"
	depends on (AW_DRM_HDMI20)
	default n
	select CEC_CORE
	select CEC_NOTIFIER
	help
		Say Y here if you want to enable cec function.
			Also enable CEC_CORE and CEC_NOTIFIER.
		Say N here if you want to disable cec function.
		If unsure, say N.

menuconfig AW_DRM_EDP
	bool "Support eDP Output"
	depends on AW_DRM
	default n
	help
		If you want edp/dp output for drm driver, select it.

config AW_DRM_EDP_PHY_USED
    def_bool n
    depends on (AW_DRM_EDP)
    default n
    help
        Selected when aw edp phy used.

config AW_DRM_INNO_EDP13
	bool "Support inno edp 1.3 PHY"
	depends on AW_DRM_EDP
	select AW_DRM_EDP_PHY_USED
	select PHY
	default n
	help
		If you want inno edp 1.3 as edp phy, select it.

config AW_DRM_EINK200
	bool "Support eink output"
	depends on AW_DRM
	default y
	help
		If you want use eink, select it.

source "bsp/drivers/video/drm/panels/Kconfig"
source "bsp/drivers/video/drm/phys/Kconfig"

endmenu
```

## bsp/drivers/video/drm/panels/Kconfig
```kconfig
menuconfig AW_DRM_PANEL
	tristate "Support panel based on DRM framework"
	depends on AW_DRM
	select PANEL
	select BACKLIGHT
	select BACKLIGHT_PWM
	default n
	help
		If you want use DRM panel, select it.

config PANEL_SQ101D_Q5DI404_84H501H
	bool "SQ101D_Q5DI404_84H501H panel"
	depends on (AW_DRM_PANEL)
	select VIDEOMODE_HELPERS
	default n
	help
		If you want to support PANEL_SQ101D_Q5DI404_84H501H panel, select it.

config PANEL_DSI_GENERAL
	bool "dsi general panel"
	depends on  AW_DRM_PANEL && AW_DRM_DSI
	default n
	help
		If you want to support general dsi panel, select it.

config PANEL_LVDS_GENERAL
	bool "lvds general panel"
	depends on (AW_DRM_PANEL)
	default n
	help
		If you want to support general lvds panel, select it.

config PANEL_RGB_GENERAL
	bool "rgb general panel"
	depends on AW_DRM_PANEL && AW_DRM_RGB
	default n
	help
		If you want to support general rgb panel, select it.

config PANEL_BP101WX1
	bool "BP101WX1 LVDS panel"
	depends on (AW_DRM_PANEL)
	select VIDEOMODE_HELPERS
	default n
	help
		If you want to support PANEL_BP101WX1 panel, select it.

config PANEL_EDP_GENERAL
    tristate "eDP general drm panel"
	depends on (AW_DRM_PANEL)
	select VIDEOMODE_HELPERS
    default n
    help
        If you want to support general edp panel, select it.

config PANEL_ES103TC1C1
	bool "ES103TC1C1 eink panel"
	depends on AW_DRM_PANEL && AW_DRM_EINK200
	select VIDEOMODE_HELPERS
	default n
	help
		If you want to support ES103TC1C1 panel, select it.

config LONTIUM_LT8912B
	bool "lontium chip lt8912b"
	default n
	help
		Single-Channel MIPI DSI Bridge to LVDS/HDMI. If you want to support lt8912b, select it.
```

## bsp/drivers/watchdog/Kconfig
```kconfig
config AW_WDT
	bool "Allwinner sunxi watchdog timer support"
	depends on WDT && ARCH_SUNXI
	default y
	help
	  Enable support for the watchdog timer in Allwinner sunxi SoCs.
```

## bsp/env/Kconfig
```kconfig
if ARCH_SUNXI


config ENV_IS_IN_SUNXI_FLASH
	bool "Environment is in sunxi flash"
	default y
	help
	  Define this if you have a sunxi Flash memory device which you
	  want to use for the environment.

config SUNXI_REDUNDAND_ENVIRONMENT
	bool "sunxi env use redundant"
	select SYS_REDUNDAND_ENVIRONMENT
	depends on ENV_IS_IN_SUNXI_FLASH
	default n
	help
	  Arch sunxi support redundant env function

endif
```

## bsp/lib/Kconfig
```kconfig
menu "sunxi Library routines"

config OPENSSL
	bool "Openssl support"
	help
	  This enables support for X509 certificate decoding.

config CRYPTO
	bool "Use Crypto lib support"
	default n
	help
	This enables support for the crypto lib which is support rsa/ecc/aes/hash.

endmenu
```

## drivers/crypto/Kconfig
```kconfig
menu "Hardware crypto devices"

source drivers/crypto/hash/Kconfig

source drivers/crypto/fsl/Kconfig

source drivers/crypto/aspeed/Kconfig

source drivers/crypto/nuvoton/Kconfig

source drivers/crypto/rsa_mod_exp/Kconfig

endmenu
```
