## bsp/configs/sun55iw6p1_mr536_nand_defconfig
```kconfig
CONFIG_ARM=y
CONFIG_ARM_SMCCC=y
CONFIG_ARCH_SUNXI=y
CONFIG_TEXT_BASE=0x4A000000
CONFIG_SYS_MALLOC_LEN=0x2000000
CONFIG_HAS_CUSTOM_SYS_INIT_SP_ADDR=y
CONFIG_CUSTOM_SYS_INIT_SP_ADDR=0x48000
CONFIG_ENV_SIZE=0x20000
CONFIG_DEFAULT_DEVICE_TREE="uboot-board"
CONFIG_SUNXI_SECURE_BOOT=y
CONFIG_MACH_SUN55IW6=y
# CONFIG_VIDEO_SUNXI is not set
CONFIG_SUNXI_KEYBOX=y
CONFIG_SUNXI_EXTERN_SECURE_MM_LAYOUT=y
CONFIG_SUNXI_BOOT_PARAM=y
CONFIG_SUNXI_SERIAL=y
CONFIG_SUNXI_MAC=y
CONFIG_SUNXI_USER_KEY=y
CONFIG_SUNXI_SPRITE=y
CONFIG_SYS_CUSTOM_LDSCRIPT=y
CONFIG_SYS_LDSCRIPT="bsp/arch/arm/mach-sunxi/u-boot.lds"
CONFIG_ANDROID_BOOT_IMAGE=y
CONFIG_PREBOOT=""
CONFIG_LOGLEVEL=6
# CONFIG_CONSOLE_MUX is not set
# CONFIG_SYS_DEVICE_NULLDEV is not set
# CONFIG_LOG_CONSOLE is not set
CONFIG_BOARD_EARLY_INIT_F=y
CONFIG_SYS_MAXARGS=64
CONFIG_SYS_BOOTM_LEN=0x2000000
CONFIG_CMD_GPIO=y
CONFIG_CMD_PWM=y
CONFIG_CMD_MMC_SWRITE=y
CONFIG_CMD_BMP=y
# CONFIG_CMD_CLS is not set
CONFIG_CMD_LOG=y
# CONFIG_ENV_IS_IN_FAT is not set
CONFIG_CLK_CCF=y
CONFIG_CLK_COMPOSITE_CCF=y
# CONFIG_CLK_SUNXI is not set
CONFIG_DM_HASH=y
CONFIG_DM_MOD_EXP=y
CONFIG_DMA=y
CONFIG_DMA_CHANNELS=y
CONFIG_MISC=y
CONFIG_MMC_HS400_SUPPORT=y
# CONFIG_MMC_SUNXI is not set
CONFIG_PHY_GIGE=y
CONFIG_PHY=y
CONFIG_PINCONF=y
CONFIG_MTD=y
CONFIG_DM_MTD=y
CONFIG_DM_PMIC=y
CONFIG_PMIC_AXP=y
CONFIG_DM_REGULATOR=y
CONFIG_REGULATOR_AXP=y
CONFIG_DM_PWM=y
CONFIG_SOUND=y
CONFIG_SPI=y
CONFIG_DM_USB_GADGET=y
CONFIG_USB_EHCI_HCD=y
# CONFIG_USB_GADGET is not set
CONFIG_VIDEO=y
# CONFIG_VIDEO_LOGO is not set
# CONFIG_VIDEO_BPP8 is not set
# CONFIG_VIDEO_BPP16 is not set
CONFIG_DISPLAY=y
CONFIG_VIDEO_BRIDGE=y
CONFIG_OSD=y
CONFIG_BMP_16BPP=y
CONFIG_BMP_24BPP=y
CONFIG_BMP_32BPP=y
# CONFIG_WDT_SUNXI is not set
CONFIG_RSA=y
# CONFIG_TOOLS_LIBCRYPTO is not set
CONFIG_AW_PINCTRL_V3=y
CONFIG_AW_GPIO=y
CONFIG_AW_GPIO_V3=y
CONFIG_AW_DMA=y
CONFIG_AW_TWI=y
CONFIG_AW_SPI=y
CONFIG_AW_PWM=y
CONFIG_AW_USB=y
CONFIG_AW_BURN=y
CONFIG_AW_FASTBOOT=y
CONFIG_AW_DRM=y
CONFIG_AW_DRM_LVDS=y
CONFIG_AW_DRM_RGB=y
CONFIG_AW_DRM_DSI=y
# CONFIG_AW_DRM_HDMI_TX is not set
# CONFIG_AW_DRM_EINK200 is not set
CONFIG_AW_DRM_PANEL=y
CONFIG_PANEL_DSI_GENERAL=y
CONFIG_PANEL_LVDS_GENERAL=y
CONFIG_PANEL_RGB_GENERAL=y
CONFIG_AW_DRM_PHY=y
CONFIG_AW_CE_DRIVER=y
CONFIG_SUNXI_CE_23=y
CONFIG_AW_EFUSE=y
CONFIG_SUNXI_ARISC_EXIST=y
CONFIG_ARISC_DEASSERT_BEFORE_KERNEL=y
CONFIG_AW_DWMAC=y
CONFIG_BOOT_RISCV=y
CONFIG_SOUND_SUNXI_SUN55IW6_CODEC=y
CONFIG_SOUND_SUNXI_BOOT_TONE=y
CONFIG_AW_REMOTEPROC=y
CONFIG_AW_RPROC_RSC_HELPER=y
CONFIG_AW_RPROC_USER_RESOURCE=y
CONFIG_CMD_SUNXI_TIMER=y
CONFIG_AW_NAND=y
CONFIG_AW_MTD_SPINAND=y
CONFIG_AW_MTD_RAWNAND=y
CONFIG_AW_MTD_RAWNAND_USE_GENERAL_DMA=y
CONFIG_CMD_SUNXI_CLK=y
CONFIG_CMD_SUNXI_PRIVATE_STORAGE=y
CONFIG_CMD_SUNXI_BURN=y
CONFIG_CMD_SUNXI_EFUSE=y
CONFIG_CMD_SUNXI_FASTBOOT=y
CONFIG_CMD_SUNXI_AUTO_FEL=y
CONFIG_CMD_SUNXI_DMA=y
CONFIG_CMD_SUNXI_SOUND=y
CONFIG_SUNXI_REDUNDAND_ENVIRONMENT=y
```

## bsp/configs/sun55iw6p1_t536_defconfig
```kconfig
CONFIG_ARM=y
CONFIG_ARM_SMCCC=y
CONFIG_ARCH_SUNXI=y
CONFIG_TEXT_BASE=0x4A000000
CONFIG_SYS_MALLOC_LEN=0x4000000
CONFIG_HAS_CUSTOM_SYS_INIT_SP_ADDR=y
CONFIG_CUSTOM_SYS_INIT_SP_ADDR=0x48000
CONFIG_DEFAULT_DEVICE_TREE="uboot-board"
CONFIG_SUNXI_SECURE_BOOT=y
CONFIG_MACH_SUN55IW6=y
# CONFIG_VIDEO_SUNXI is not set
CONFIG_SUNXI_KEYBOX=y
CONFIG_SUNXI_EXTERN_SECURE_MM_LAYOUT=y
CONFIG_SUNXI_BOOT_PARAM=y
CONFIG_SUNXI_FDT_ADDR=0x42000000
CONFIG_SUNXI_SERIAL=y
CONFIG_SUNXI_MAC=y
CONFIG_SUNXI_USER_KEY=y
# CONFIG_LOGF_MODULE is not set
# CONFIG_LOGF_LEVEL is not set
# CONFIG_LOGF_DEVNAME is not set
CONFIG_SUNXI_SPRITE=y
CONFIG_SUNXI_SPRITE_CARTOON=y
CONFIG_SYS_CUSTOM_LDSCRIPT=y
CONFIG_SYS_LDSCRIPT="bsp/arch/arm/mach-sunxi/u-boot.lds"
CONFIG_ANDROID_BOOT_IMAGE=y
CONFIG_BOOTDELAY=0
CONFIG_AUTOBOOT_KEYED=y
CONFIG_AUTOBOOT_PROMPT="Autoboot in %d seconds , Hit Ctrl+C to stop autoboot\n"
CONFIG_AUTOBOOT_STOP_STR="\x03"
CONFIG_LOGLEVEL=6
# CONFIG_LOG_CONSOLE is not set
CONFIG_BOARD_EARLY_INIT_F=y
CONFIG_SYS_MAXARGS=64
CONFIG_SYS_BOOTM_LEN=0x2000000
CONFIG_CMD_CLK=y
CONFIG_CMD_GPIO=y
CONFIG_CMD_PWM=y
CONFIG_CMD_I2C=y
CONFIG_CMD_MMC_SWRITE=y
CONFIG_CMD_LOG=y
# CONFIG_ENV_IS_IN_FAT is not set
CONFIG_CLK_CCF=y
CONFIG_CLK_COMPOSITE_CCF=y
# CONFIG_CLK_SUNXI is not set
CONFIG_DM_HASH=y
CONFIG_DM_MOD_EXP=y
CONFIG_MMC_HS400_SUPPORT=y
# CONFIG_MMC_SUNXI is not set
CONFIG_MTD=y
CONFIG_SPI_FLASH_ATMEL=y
CONFIG_SPI_FLASH_GIGADEVICE=y
CONFIG_SPI_FLASH_ISSI=y
CONFIG_SPI_FLASH_MACRONIX=y
CONFIG_SPI_FLASH_SPANSION=y
CONFIG_SPI_FLASH_STMICRO=y
CONFIG_SPI_FLASH_SST=y
CONFIG_SPI_FLASH_WINBOND=y
CONFIG_SPI_FLASH_XMC=y
CONFIG_SPI_FLASH_XTX=y
# CONFIG_SPI_FLASH_USE_4K_SECTORS is not set
CONFIG_SPI_FLASH_MTD=y
CONFIG_RGMII=y
CONFIG_PINCONF=y
CONFIG_DM_PMIC=y
CONFIG_PMIC_AXP=y
CONFIG_REGULATOR_AXP=y
CONFIG_DM_PWM=y
CONFIG_SPI=y
CONFIG_USB_EHCI_HCD=y
# CONFIG_VIDEO_LOGO is not set
CONFIG_VIDEO_BMP_RLE8=y
# CONFIG_WDT_SUNXI is not set
CONFIG_RSA=y
# CONFIG_TOOLS_LIBCRYPTO is not set
CONFIG_AW_PINCTRL_V3=y
CONFIG_AW_GPIO=y
CONFIG_AW_GPIO_V3=y
CONFIG_AW_TWI=y
CONFIG_AW_SPI=y
CONFIG_AW_PWM=y
CONFIG_AW_USB=y
CONFIG_AW_BURN=y
CONFIG_USB_EHCI_HCD_SUNXI=y
CONFIG_AW_DRM=y
CONFIG_AW_DRM_LVDS=y
CONFIG_AW_DRM_RGB=y
CONFIG_AW_DRM_DSI=y
# CONFIG_AW_DRM_HDMI_TX is not set
# CONFIG_AW_DRM_EINK200 is not set
CONFIG_AW_DRM_PANEL=y
CONFIG_PANEL_DSI_GENERAL=y
CONFIG_PANEL_LVDS_GENERAL=y
CONFIG_PANEL_RGB_GENERAL=y
CONFIG_LONTIUM_LT8912B=y
CONFIG_AW_DRM_PHY=y
CONFIG_AW_CE_DRIVER=y
CONFIG_SUNXI_CE_23=y
CONFIG_AW_EFUSE=y
CONFIG_SPINOR_UBOOT_OFFSET=256
CONFIG_SPINOR_LOGICAL_OFFSET=2144
CONFIG_SPINOR_UBOOT_SECURE_OFFSET=256
CONFIG_SPINOR_LOGICAL_SECURE_OFFSET=2144
CONFIG_SUNXI_ARISC_EXIST=y
CONFIG_ARISC_DEASSERT_BEFORE_KERNEL=y
CONFIG_AW_DWMAC=y
CONFIG_BOOT_RISCV=y
CONFIG_AW_REMOTEPROC=y
CONFIG_AW_RPROC_RSC_HELPER=y
CONFIG_AW_RPROC_USER_RESOURCE=y
CONFIG_CMD_SUNXI_CLK=y
CONFIG_CMD_SUNXI_PRIVATE_STORAGE=y
CONFIG_CMD_SUNXI_BURN=y
CONFIG_CMD_SUNXI_EFUSE=y
CONFIG_CMD_SUNXI_UBI=y
CONFIG_CMD_SUNXI_AMP=y
CONFIG_CMD_SUNXI_SPRITE=y
```

## bsp/configs/sun55iw6p1_t536_nand_defconfig
```kconfig
CONFIG_ARM=y
CONFIG_ARM_SMCCC=y
CONFIG_ARCH_SUNXI=y
CONFIG_TEXT_BASE=0x4A000000
CONFIG_SYS_MALLOC_LEN=0x4000000
CONFIG_HAS_CUSTOM_SYS_INIT_SP_ADDR=y
CONFIG_CUSTOM_SYS_INIT_SP_ADDR=0x48000
CONFIG_DEFAULT_DEVICE_TREE="uboot-board"
CONFIG_SUNXI_SECURE_BOOT=y
CONFIG_MACH_SUN55IW6=y
# CONFIG_VIDEO_SUNXI is not set
CONFIG_SUNXI_KEYBOX=y
CONFIG_SUNXI_EXTERN_SECURE_MM_LAYOUT=y
CONFIG_SUNXI_BOOT_PARAM=y
CONFIG_SUNXI_FDT_ADDR=0x42000000
CONFIG_SUNXI_SERIAL=y
CONFIG_SUNXI_MAC=y
CONFIG_SUNXI_USER_KEY=y
# CONFIG_LOGF_MODULE is not set
# CONFIG_LOGF_LEVEL is not set
# CONFIG_LOGF_DEVNAME is not set
CONFIG_SUNXI_SPRITE=y
CONFIG_SUNXI_SPRITE_CARTOON=y
CONFIG_SYS_CUSTOM_LDSCRIPT=y
CONFIG_SYS_LDSCRIPT="bsp/arch/arm/mach-sunxi/u-boot.lds"
CONFIG_ANDROID_BOOT_IMAGE=y
CONFIG_LOGLEVEL=6
# CONFIG_LOG_CONSOLE is not set
CONFIG_BOARD_EARLY_INIT_F=y
CONFIG_SYS_MAXARGS=64
CONFIG_SYS_BOOTM_LEN=0x2000000
CONFIG_CMD_GPIO=y
CONFIG_CMD_PWM=y
CONFIG_CMD_MMC_SWRITE=y
CONFIG_CMD_LOG=y
# CONFIG_ENV_IS_IN_FAT is not set
# CONFIG_NET is not set
CONFIG_CLK_CCF=y
CONFIG_CLK_COMPOSITE_CCF=y
# CONFIG_CLK_SUNXI is not set
CONFIG_DM_HASH=y
CONFIG_DM_MOD_EXP=y
CONFIG_DMA=y
CONFIG_DMA_CHANNELS=y
CONFIG_MISC=y
# CONFIG_MMC_SUNXI is not set
CONFIG_MTD=y
CONFIG_DM_MTD=y
# CONFIG_SPI_FLASH is not set
CONFIG_DM_PMIC=y
CONFIG_PMIC_AXP=y
CONFIG_DM_REGULATOR=y
CONFIG_REGULATOR_AXP=y
CONFIG_DM_PWM=y
CONFIG_SPI=y
CONFIG_SPI_MEM=y
# CONFIG_WDT_SUNXI is not set
CONFIG_RSA=y
# CONFIG_TOOLS_LIBCRYPTO is not set
CONFIG_AW_PINCTRL_V3=y
CONFIG_AW_GPIO=y
CONFIG_AW_GPIO_V3=y
CONFIG_AW_DMA=y
CONFIG_AW_SPI=y
CONFIG_AW_PWM=y
CONFIG_AW_USB=y
CONFIG_AW_BURN=y
CONFIG_AW_CE_DRIVER=y
CONFIG_SUNXI_CE_23=y
CONFIG_AW_EFUSE=y
CONFIG_AW_NAND=y
CONFIG_AW_MTD_SPINAND=y
CONFIG_AW_MTD_RAWNAND=y
CONFIG_AW_MTD_RAWNAND_USE_GENERAL_DMA=y
CONFIG_SUNXI_ARISC_EXIST=y
CONFIG_ARISC_DEASSERT_BEFORE_KERNEL=y
CONFIG_BOOT_RISCV=y
CONFIG_AW_REMOTEPROC=y
CONFIG_AW_RPROC_RSC_HELPER=y
CONFIG_AW_RPROC_USER_RESOURCE=y
CONFIG_CMD_SUNXI_CLK=y
CONFIG_CMD_SUNXI_PRIVATE_STORAGE=y
CONFIG_CMD_SUNXI_BURN=y
CONFIG_CMD_SUNXI_EFUSE=y
CONFIG_CMD_SUNXI_SPRITE=y
```

## bsp/configs/sun65iw1p1_defconfig
```kconfig
CONFIG_ARM=y
CONFIG_ARM_SMCCC=y
CONFIG_ARCH_SUNXI=y
CONFIG_TEXT_BASE=0x43000000
CONFIG_SYS_MALLOC_LEN=0x1000000
CONFIG_HAS_CUSTOM_SYS_INIT_SP_ADDR=y
CONFIG_CUSTOM_SYS_INIT_SP_ADDR=0x48000
CONFIG_DEFAULT_DEVICE_TREE="uboot-board"
CONFIG_MACH_SUN65IW1=y
# CONFIG_VIDEO_SUNXI is not set
CONFIG_SUNXI_PRIVATE_STORAGE=y
CONFIG_SUNXI_BOOT_PARAM=y
CONFIG_SUNXI_FDT_ADDR=0x42000000
CONFIG_SUNXI_FPGA_PLATFORM=y
CONFIG_PHYS_64BIT=y
CONFIG_SYS_CUSTOM_LDSCRIPT=y
CONFIG_SYS_LDSCRIPT="bsp/arch/arm/mach-sunxi/u-boot.lds"
CONFIG_ANDROID_BOOT_IMAGE=y
CONFIG_LOGLEVEL=6
CONFIG_BOARD_EARLY_INIT_F=y
CONFIG_SYS_MAXARGS=64
CONFIG_SYS_BOOTM_LEN=0x2000000
CONFIG_CMD_GPIO=y
CONFIG_CMD_PWM=y
CONFIG_CMD_MMC_SWRITE=y
CONFIG_CMD_LOG=y
# CONFIG_ENV_IS_IN_FAT is not set
# CONFIG_NET is not set
CONFIG_CLK_CCF=y
CONFIG_CLK_COMPOSITE_CCF=y
# CONFIG_CLK_SUNXI is not set
# CONFIG_MMC_SUNXI is not set
CONFIG_DM_PMIC=y
CONFIG_PMIC_AXP=y
CONFIG_DM_REGULATOR=y
CONFIG_REGULATOR_AXP=y
CONFIG_DM_PWM=y
# CONFIG_WDT_SUNXI is not set
CONFIG_RSA=y
# CONFIG_TOOLS_LIBCRYPTO is not set
CONFIG_AW_GPIO=y
CONFIG_AW_PWM=y
CONFIG_CMD_SUNXI_CLK=y
CONFIG_CMD_SUNXI_PRIVATE_STORAGE=y
CONFIG_OPENSSL=y
```

## bsp/configs/sun8iw21p1_nor_defconfig
```kconfig
CONFIG_ARM=y
CONFIG_ARM_SMCCC=y
CONFIG_ARCH_SUNXI=y
CONFIG_TEXT_BASE=0x42000000
CONFIG_SYS_MALLOC_LEN=0x1000000
CONFIG_HAS_CUSTOM_SYS_INIT_SP_ADDR=y
CONFIG_CUSTOM_SYS_INIT_SP_ADDR=0x27000
CONFIG_ENV_SIZE=0x20000
CONFIG_DEFAULT_DEVICE_TREE="uboot-board"
CONFIG_MACH_SUN8IW21=y
# CONFIG_VIDEO_SUNXI is not set
CONFIG_SUNXI_NOR_IMG=y
CONFIG_SUNXI_KEYBOX=y
CONFIG_SUNXI_EXTERN_SECURE_MM_LAYOUT=y
CONFIG_SUNXI_BOOT_PARAM=y
CONFIG_SUNXI_FDT_ADDR=0x42000000
CONFIG_SUNXI_SERIAL=y
CONFIG_SUNXI_MAC=y
CONFIG_SUNXI_USER_KEY=y
# CONFIG_SYS_MALLOC_CLEAR_ON_INIT is not set
CONFIG_SYS_CUSTOM_LDSCRIPT=y
CONFIG_SYS_LDSCRIPT="bsp/arch/arm/mach-sunxi/u-boot.lds"
CONFIG_ANDROID_BOOT_IMAGE=y
CONFIG_LOGLEVEL=6
# CONFIG_LOG_CONSOLE is not set
CONFIG_BOARD_EARLY_INIT_F=y
CONFIG_SYS_MAXARGS=64
CONFIG_SYS_BOOTM_LEN=0x2000000
CONFIG_CMD_GPIO=y
CONFIG_CMD_PWM=y
CONFIG_CMD_MMC_SWRITE=y
CONFIG_CMD_MTD=y
CONFIG_CMD_SF_TEST=y
CONFIG_CMD_SPI=y
CONFIG_CMD_LOG=y
# CONFIG_ENV_IS_IN_FAT is not set
# CONFIG_ENV_IS_IN_SPI_FLASH is not set
# CONFIG_NET is not set
CONFIG_CLK_CCF=y
CONFIG_CLK_COMPOSITE_CCF=y
# CONFIG_CLK_SUNXI is not set
CONFIG_DM_HASH=y
CONFIG_DM_MOD_EXP=y
CONFIG_DMA=y
CONFIG_DMA_CHANNELS=y
CONFIG_MISC=y
# CONFIG_MMC_SUNXI is not set
CONFIG_MTD=y
CONFIG_DM_MTD=y
CONFIG_SPI_FLASH_ATMEL=y
CONFIG_SPI_FLASH_EON=y
CONFIG_SPI_FLASH_GIGADEVICE=y
CONFIG_SPI_FLASH_ISSI=y
CONFIG_SPI_FLASH_MACRONIX=y
CONFIG_SPI_FLASH_SPANSION=y
CONFIG_SPI_FLASH_STMICRO=y
CONFIG_SPI_FLASH_SST=y
CONFIG_SPI_FLASH_WINBOND=y
CONFIG_SPI_FLASH_XMC=y
CONFIG_SPI_FLASH_XTX=y
# CONFIG_SPI_FLASH_USE_4K_SECTORS is not set
CONFIG_SPI_FLASH_MTD=y
CONFIG_DM_PMIC=y
CONFIG_PMIC_AXP=y
CONFIG_DM_REGULATOR=y
CONFIG_REGULATOR_AXP=y
CONFIG_DM_PWM=y
CONFIG_SPI=y
# CONFIG_WDT_SUNXI is not set
CONFIG_RSA=y
# CONFIG_TOOLS_LIBCRYPTO is not set
CONFIG_AW_GPIO=y
CONFIG_AW_DMA=y
CONFIG_AW_TWI=y
CONFIG_AW_SPI=y
CONFIG_AW_PWM=y
CONFIG_AW_USB=y
CONFIG_AW_BURN=y
CONFIG_AW_FASTBOOT=y
CONFIG_AW_CE_DRIVER=y
CONFIG_SUNXI_CE_23=y
CONFIG_AW_EFUSE=y
CONFIG_CMD_SUNXI_CLK=y
CONFIG_SPINOR_LOGICAL_OFFSET=2400
CONFIG_SPINOR_LOGICAL_SECURE_OFFSET=2400
CONFIG_CMD_SUNXI_PRIVATE_STORAGE=y
CONFIG_CMD_SUNXI_BURN=y
CONFIG_CMD_SUNXI_EFUSE=y
CONFIG_CMD_SUNXI_FASTBOOT=y
CONFIG_CMD_SUNXI_AUTO_FEL=y
CONFIG_SUNXI_REDUNDAND_ENVIRONMENT=y
```

## bsp/drivers/Kconfig
```kconfig
# SPDX-License-Identifier: GPL-2.0-only

menu "Device Drivers"

source bsp/drivers/clk/Kconfig
source bsp/drivers/pinctrl/Kconfig
source bsp/drivers/gpio/Kconfig
source bsp/drivers/dma/Kconfig
source bsp/drivers/twi/Kconfig
source bsp/drivers/spi/Kconfig
source bsp/drivers/pwm/Kconfig
source bsp/drivers/watchdog/Kconfig
source bsp/drivers/usb/Kconfig
source bsp/drivers/pcie/Kconfig
source bsp/drivers/phy/Kconfig
source bsp/drivers/mmc/Kconfig
source bsp/drivers/block/Kconfig
source bsp/drivers/video/Kconfig
source bsp/drivers/crypto/Kconfig
source bsp/drivers/misc/Kconfig
source bsp/drivers/bootcount/Kconfig
source bsp/drivers/mtd/Kconfig
source bsp/drivers/spi/Kconfig
source bsp/drivers/arisc/Kconfig
source bsp/drivers/dwmac/Kconfig
source "bsp/drivers/riscv/Kconfig"
source bsp/drivers/adc/Kconfig
source bsp/drivers/sound/Kconfig
source bsp/drivers/remoteproc/Kconfig

endmenu
```

## bsp/drivers/adc/Kconfig
```kconfig
config SUNXI_GPADC
	bool "Enable Sunxi GPADC driver"
	help
	  This enables basic driver for Sunxi GPADC.
```

## bsp/drivers/arisc/Kconfig
```kconfig
config SUNXI_ARISC_EXIST
	bool "support sunxi arisc"
	default n

config ARISC_DEASSERT_BEFORE_KERNEL
	bool "sunxi arisc deassert before kernel"
	default n

config SUNXI_UBOOT_POWER_OFF
	bool "Sunxi uboot power off"
	default n
	---help---
	Select this to enable support for uboot power off
```

## bsp/drivers/block/Kconfig
```kconfig
config AW_FLASH
	bool # "Support sunxi_flash devices"
	depends on DM
	help
	  Enable support for sunxi_flash devices, such as spinor, MMC and nand
	  flash sticks.
```

## bsp/drivers/bootcount/Kconfig
```kconfig
config BOOTCOUNT_RTC
	bool "Sunxi boot counter in rtc register"
	depends on BOOTCOUNT_LIMIT
	help
	  If BOOTCOUNT_RTC is set,"bootcount" will be saved in RTC register

config SUNXI_BOOTCOUNT_RTC_INDEX
	hex "Sunxi bootcount rtc index"
	depends on BOOTCOUNT_RTC
	default 0x5
	help
	  sunxi rtc GP_DATA_REGn, n = 0~7, default use 5
```

## bsp/drivers/clk/Kconfig
```kconfig
config AW_CLK
	bool "Clock support for Allwinner SoCs"
	depends on CLK && ARCH_SUNXI
	select DM_RESET
	select SPL_DM_RESET if SPL_CLK
	default y
	help
	  This enables support for common clock driver API on Allwinner
	  SoCs.

if AW_CLK

config AW_CLK_SUN8IW21
	bool "Clock driver for Allwinner sun8iw21"
	help
	  This enables common clock driver support for platforms based
	  on Allwinner SUN8IW21 SoC.

config AW_CLK_SUN65IW1
	bool "Clock driver for Allwinner sun65iw1"
	help
	  This enables common clock driver support for platforms based
	  on Allwinner SUN65IW1 SoC.

config AW_CLK_SUN55IW6
	bool "Clock driver for Allwinner sun55iw6"
	help
	  This enables common clock driver support for platforms based
	  on Allwinner SUN55IW6 SoC.

endif # CLK_SUNXI
```

## bsp/drivers/dma/Kconfig
```kconfig
config AW_DMA
         bool "SUNXI DMA driver"
         help
           Support for SUNXI DMA controller.
```

## bsp/drivers/gpio/Kconfig
```kconfig
#
# GPIO infrastructure and drivers
#

config AW_GPIO
	bool "Allwinner GPIO driver"
	depends on ARCH_SUNXI
	depends on GPIO
	select SPL_STRTO if SPL
	help
	  Support the GPIO device in Allwinner SoCs.

menu "Allwinner GPIO Version"
	depends on AW_GPIO
choice
	prompt "sunxi gpio ip version"
	default SUNXI_GPIO_V1

config SUNXI_GPIO_V1
	bool "sunxi gpio v1"

config SUNXI_GPIO_V2
	bool "sunxi gpio v2"

config AW_GPIO_V3
	depends on DM_GPIO
	bool "sunxi gpio v3"
endchoice
endmenu
```

## bsp/drivers/misc/Kconfig
```kconfig
config AW_EFUSE
	bool "Enable Allwinner sunxi efuse driver"
	depends on MISC
	help
	  Enable support for reading and writing the efuse on the
	  allwinner sunxi SoCs.
```

## bsp/drivers/mmc/Kconfig
```kconfig
config AW_MMC
	bool "Allwinner sunxi SD/MMC Host Controller support"
	depends on ARCH_SUNXI
	default y
	help
	  This selects support for the SD/MMC Host Controller on
	  Allwinner sunxi SoCs.

if AW_MMC

config SUNXI_BOOT0_SDMMC_BACKUP_START_ADDR
	int "backup boot0 offset"
	default 256
	help
	  offset to write backup boot0, unit:sector(512 bytes)

endif
```
