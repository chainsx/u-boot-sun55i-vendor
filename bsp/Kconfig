## bsp/drivers/mtd/Kconfig
```kconfig
menu "AW-NAND Support"

config AW_NAND
	bool "SUNXI awnand driver"
	default n
	help
	  Support SUNXI awnand driver.

if AW_NAND
source "bsp/drivers/mtd/awnand/Kconfig"
endif

endmenu

source "bsp/drivers/mtd/spi/Kconfig"
```

## bsp/drivers/mtd/awnand/Kconfig
```kconfig
config AW_MTD_SPINAND
	tristate "Allwinner MTD SPINAND Device Support"
	depends on ARCH_SUNXI
	select MTD_UBI
	select CMD_SUNXI_MTDPARTS
	select CMD_UBIFS
	select CMD_SUNXI_UBI
	select LZO
	help
	  Enables support for SPINAND Flash chips on Allwinner SoCs.
	  It's different with Allwinner's privately nand driver that it use
	  ubi system rather than Allwinner's NFTL.

config AW_MTD_RAWNAND
	tristate "Allwinner MTD RAWNAND(SLC) Device Support"
	depends on ARCH_SUNXI
	select MTD_UBI
	select SUNXI_NAND
	select SUNXI_COMM_NAND_V1
	select CMD_SUMXI_MTDPARTS
	select CMD_UBIFS
	select CMD_SUNXI_UBI
	select LZO
	help
	  Enables support for RAWNAND Flash chips on Allwinner SoCs.
	  It's different with Allwinner's privately nand driver that it use
	  ubi system rather than Allwinner's NFTL.

config RAW_KERNEL
	bool "Kernel images are stored on physical partitions"
	help
	  Enables support kernel images are stored on physical partitions.

config KERNEL_SIZE_BYTE
	int "Kernel image size(Byte)"
	depends on RAW_KERNEL
	default 0
	help
	  To accurately read the complete kernel image, you need to set
	  the kernel image size (in bytes) when using the RAW-boot function.

config SIMULATE_MULTIPLANE
	bool "enable simulate multiplane"
	default n
	help
	  spinand do not support multiplane. In order to adapt to aw nand
	  we simulate multiplane. If set, the common physical layer should
	  merge two continuous physical block to 'super block' for logical
	  layer.

	  Merge pages in two adjacent blocks with the same page num to super
	  page. Merge adjacent blocks to super block.

	  *   phy-block0   phy-block1    = super block 0
	  * |------------|------------|
	  * | phy-page 0 | phy-page 0 |  = super page 0 on super block 0
	  * | phy-page 1 | phy-page 1 |  = super page 1 on super block 0
	  * |     ...    |     ...    |
	  * |------------|------------|

	  If unsure, say Y.

if AW_MTD_SPINAND
source "bsp/drivers/mtd/awnand/spinand/Kconfig"
endif

if AW_MTD_RAWNAND
source "bsp/drivers/mtd/awnand/rawnand/Kconfig"
endif
```

## bsp/drivers/mtd/awnand/spinand/Kconfig
```kconfig
config AW_SPINAND_ENABLE_PHY_CRC16
	bool "check crc16 for each page on spinand physical layer"
	help
	  It is experimental.
	  To check crc16 for each page on spinand physical layer.

config AW_SPINAND_PSTORE_MTD_PART
	bool "create pstore mtd partition for aw ubi spinand"
	depends on AW_MTD_SPINAND
	help
	  Whether create pstore mtd partition, which is need by pstroe-blk.
	  If you want linux kernel dump log to spinand when oops/panic, you
	  should create pstreo mtd partition by this configure.

	  If unsure, say no.

config AW_MTD_SPINAND_UBOOT_BLKS
	int "Blocks Count Reserved For Uboot"
	depends on AW_MTD_SPINAND
	default 24
	range 0 33
	help
	  How many reserved blocks for uboot and uboot's copy?
	  It's must in range [1,33]. If 0, set it automatically.
	  The larger it is, the more uboot copies to save.

	  WARNING!!!
	  If it is change, the secure storage may be erased!
	  Once changed, the image will be incompatible to old image.

	  if unsure, set it 0.

config AW_MTD_SPINAND_OOB_RAW_SPARE
	bool "support mtd read oob raw spare data"
	depends on AW_MTD_SPINAND
	default n
	help
		aw spinand do not support read raw spare data by default, say yes to
		support mtd read oob raw spare data.

		if enable AW_MTD_SPINAND_OOB_RAW_SPARE, the oob is equivalent to spare area,
		otherwise oob is the user data spare area in ecc protected.

config AW_MTD_SPINAND_FASTBOOT
	bool "support fastboot"
	depends on AW_MTD_SPINAND
	default n
	help
		boot0 to load kernel and jump kernel

config BIMAGE_SIZE
	int "bimage size"
	depends on AW_MTD_SPINAND_FASTBOOT
	default 20
	help
		unit is MiByte, it serves as the size of the boot partition
```

## bsp/drivers/mtd/spi/Kconfig
```kconfig
menu "AW-SPINOR Support"

config AW_SPINOR
	bool "Support sunxi spinor devices"
	depends on AW_SPI
	default y if SPI_FLASH
	select USE_SYS_MAX_FLASH_BANKS
	help
	  Enable support for sunxi spinor devices. These provide a block-level interface
	  which permits reading, writing and (in some cases) erasing blocks.

if AW_SPINOR
config SPINOR_UBOOT_OFFSET
	int "uboot offset for boot from spinor"
	default 128
	help
	 spinor address is offset*512 bytes.

config SPINOR_LOGICAL_OFFSET
	int "logic address for read/write"
	default 2016
	help
	  logic address for mbr and partitions(1M-MBRSIZE = 2048-32).
	  spinor address is offset*512 bytes.

config SPINOR_UBOOT_SECURE_OFFSET
	int "secure uboot offset for boot from spinor"
	default 128
	help
	 spinor address is offset*512 bytes.

config SPINOR_LOGICAL_SECURE_OFFSET
	int "secure logic address for read/write"
	default 2016
	help
	  logic address for mbr and partitions(1M-MBRSIZE = 2048-32).
	  spinor address is offset*512 bytes.
endif

endmenu
```
