## bsp/Kconfig
```kconfig
# SPDX-License-Identifier: GPL-2.0

menu "Allwinner uboot BSP"

config AW_BSP_ALWAYS_N
        bool
        default n

source "bsp/drivers/Kconfig"
source "bsp/cmd/Kconfig"
source "bsp/env/Kconfig"
source "bsp/lib/Kconfig"

endmenu
```

## bsp/board/sunxi/Kconfig
```kconfig
choice
	prompt "SPL Image Type"
	default SPL_IMAGE_TYPE_SUNXI_EGON

config SPL_IMAGE_TYPE_SUNXI_EGON
	bool "eGON (normal)"
	help
	  Select this option to embed the SPL binary in an eGON.BT0 image,
	  which is compatible with the normal boot ROM (NBROM).

	  This is usually the correct option to choose.

config SPL_IMAGE_TYPE_SUNXI_TOC0
	bool "TOC0 (secure)"
	help
	  Select this option to embed the SPL binary in a TOC0 image,
	  which is compatible with the secure boot ROM (SBROM).

endchoice

config SPL_IMAGE_TYPE
	string
	default "sunxi_egon" if SPL_IMAGE_TYPE_SUNXI_EGON
	default "sunxi_toc0" if SPL_IMAGE_TYPE_SUNXI_TOC0

config SYS_TEXT_BASE
	default 0x43000000 if ARCH_SUNXI
	hex "Text Base"
	help
	  The address in memory that U-Boot will be running from, initially.

config SUNXI_NOR_IMG
	bool "crate u-boot-nor.bin"
	default false

menu "OPTEE_VERSION"

choice
	prompt "select optee version"
	default OPTEE25 if MACH_SUN8IW18

config OPTEE25
	bool "use optee 2.5 smc api"
	---help---
	Select this to use optee 2.5 smc api.

config NOT_USE_OPTEE25
	bool "no use optee 2.5 smc api"
	---help---
	Select this to no use optee 2.5 smc api.
endchoice

endmenu

config SUNXI_PRIVATE_STORAGE
	bool "Sunxi Sprite Private Storage"
	help
	  Enable supprot for sunxi private storage

config SUNXI_KEYBOX
	bool "Sunxi Keybox Private Storage"
	help
	  Enable supprot for sunxi keybox private storage

config SUNXI_IMAGE_VERIFIER
	bool "Sunxi image verify support"
	default n
	select SUNXI_CE_DRIVER
	select OPENSSL

if SUNXI_KEYBOX
config SECURE_STORAGE_KEY_HUK
	bool "Keybox Crypto by HUK"
	default y
	help
	  Enable sunxi keybox crypto by huk
endif

config SUNXI_EXTERN_SECURE_MM_LAYOUT
	bool "sunxi secure memory lay defined in fdt"
	default n
	help
		when enable, uboot try to load secure memory layout
		from fdt(shm\ta ram). Notify secure os configurated
		layout and mard those memory as "reserved memory" in
		fdt

config LAST_PARTITION_NAME
    string "set last partition name"
    default "UDISK"
    help
      Last partition name.

config SUNXI_BOOT_PARAM
	bool "enable sunxi boot param"
	help
		store startup related parameters

config SUNXI_FDT_ADDR
	hex "device tree address for kernel"
	default 0
	---help---
	set the address for start_kernel.

config SUNXI_FDT_MALLOC_SIZE
	hex "device tree size for kernel"
	default 0x40000
	---help---
	set the size for start_kernel.

config AW_BSP
	bool "Allwinner Platform"
	default y
	select PINCTRL
	help
		This enables support for Allwinner sunxi based SoCs like the A64.

config SUNXI_SERIAL
	bool "Update snum to bootargs"
	depends on AW_EFUSE
	default n

config SUNXI_MAC
	bool "sunxi_mac"
	default n
	help
		when enabled, uboot read mac addr and send to system via cmdline

config SUNXI_USER_KEY
	bool "user key"
	default n
	select SUNXI_PRIVATE_STORAGE
	select CMD_FAT
	help
		when enable, uboot try to read cmdline data from secure storage

config SUNXI_SET_EFUSE_POWER
	bool "set sunxi efuse power"
	default n
	help
		Efuse is powered by the pmu.

config SUNXI_ENABLE_FEL_VERIFY
	bool "enable sunxi sign fel verify"
	default n
	help
		Burn efuse sign fel bit

config SUNXI_LOG
	bool "Sunxi out put log with timestamp"
	depends on LOG
	default y

config AW_STACKTRACE
	bool "allwinner stacktrace"
	depends on ARM64 || ARM
	default n

config SUNXI_FPGA_PLATFORM
	bool "build for fpga platform"
	help
		fpga board have special treament for resources like
		clock or io, this config enable thoes special treament

config SUNXI_VERIFY_DSP
	bool "sunxi verify dsp"
	default n
	depends on XTENSA_DSP
	depends on SUNXI_SECURE_BOOT
	help
		when enable, uboot will verify the dsp bin.

config SUNXI_VERIFY_RISCV
	bool "sunxi verify riscv"
	default n
	depends on SUNXI_SECURE_BOOT
	help
		when enable, secure boot uboot will verify the riscv bin.

config SUNXI_VERIFY_RV
        bool "sunxi verify rv"
        default n
        depends on BOOT_RISCV
        help
                when enable, uboot will verify the rv0 & rv1.

config SUNXI_IMAGE_HEADER
	bool "sunxi verify with image header"
	default n
	help
		when enable, uboot will verify with image header.

config LOGF_TIME
	bool "Add time information before the output log"
	default y

config LOGF_MODULE
	bool "Add cat information before the output log"
	default y

config LOGF_LEVEL
	bool "Add level information before the output log"
	default y

config LOGF_DEVNAME
	bool "Add level information before the output log"
	default y

source "bsp/board/sunxi/sprite/Kconfig"

config SUNXI_BOOT_ENV_INLINE
	bool "sunxi boot env set in uboot"
	default n
	depends on ENV_IS_IN_SUNXI_FLASH
	help
		support set boot env in uboot, which will cover partition's env
if SUNXI_BOOT_ENV_INLINE
config SUNXI_BOOT_ENV_STRING
	string "default boot env"
	help
		This env string can not be changed by env partition.
endif

config SUNXI_ANDROID_OVERLAY
	bool "sunxi ANDROID fdt library overlay support"
	depends on OF_LIBFDT_OVERLAY
	default n
	help
		This enables the SUNXI ANDROID FDT library (libufdt) overlay support.

config SUNXI_SWITCH_SYSTEM
	bool "sunxi switch system"
	default n
	select BOOTCOUNT_LIMIT
	select BOOTCOUNT_ENV
	help
	    Supports automatic switching and damaged switching
```

## bsp/board/sunxi/sprite/Kconfig
```kconfig
menuconfig SUNXI_SPRITE
    bool "Sunxi Sprite support"
    select AW_FLASH
    help
      Enable support for sunxi efex devices.

if SUNXI_SPRITE

config SUNXI_SPRITE_CARTOON
	bool "Sunxi Sprite cartoon support"
	select SUNXI_FLASH
	default n
	help
	  Enable support for sunxi Sprite cartoon(display)

endif
```

## bsp/cmd/Kconfig
```kconfig
menu "sunxi commands"

config CMD_SUNXI_UPDATE
	bool "sunxi update"
	depends on OF_LIBFDT
	default y
	help
	  sunxi update cmd before bootm

config CMD_SUNXI_TIMER
	bool "timer test"
	help
	  Activate this option to test sunxi timer.

config CMD_SUNXI_CLK
	bool "clk test"
	help
	  Activate this option to test sunxi clk.

config CMD_SUNXI_PRIVATE_STORAGE
	bool "securestorage cmd"
	help
	  securestorage command line read and write test use.

config CMD_SUNXI_EFEX
	bool "sunxi efex test"
	default y
	help
	  Activate this option to test sunxi fel mode.

config CMD_SUNXI_BURN
	bool "pburn test"
	depends on AW_BURN
	help
	  Activate this option to test sunxi burn.

config CMD_SUNXI_EFUSE
	bool "sunxi efuse commands"
	depends on AW_EFUSE
	default n
	help
	  Enable useful commands for the sunxi Soc efuse.

config CMD_SUNXI_FASTBOOT
    bool "enable fastboot"
    default n
    select SUNXI_FASTBOOT
    help
      enable fastboot.

config CMD_SUNXI_AUTO_FEL
    bool "enable auto fel"
    default n
    select SUNXI_BURN
    help
      enable auto fel function by probe MP tools.

config CMD_SUNXI_DMA
       bool "sunxi dma test"
       default n
       help
         Command to test dma test.

config CMD_SUNXI_NVEDIT
       bool "nvedit file"
       default y
       help
         Nvedit file.

config CMD_SUNXI_FLASH
	bool "sunxi flash test"
	default y
	help
	  Activate this option to test sunxi flash.

config CMD_SUNXI_MTDPARTS
	bool "MTD partition support"
	depends on MTD
	help
	  MTD partitioning tool support.
	  It is strongly encouraged to avoid using this command
	  anymore along with 'sf', 'nand', 'onenand'. One can still
	  declare the partitions in the mtdparts environment variable
	  but better use the MTD stack and the 'mtd' command instead.

config CMD_SUNXI_UBI
	tristate "Enable UBI - Unsorted block images commands"
	select MTD_UBI
	help
	  UBI is a software layer above MTD layer which admits use of LVM-like
	  logical volumes on top of MTD devices, hides some complexities of
	  flash chips like wear and bad blocks and provides some other useful
	  capabilities. Please, consult the MTD web site for more details
	  (www.linux-mtd.infradead.org). Activate this option if you want
	  to use U-Boot UBI commands.
	  It is also strongly encouraged to also enable CONFIG_MTD to get full
	  partition support.

config CMD_UBIFS
	tristate "Enable UBIFS - Unsorted block images filesystem commands"
	depends on CMD_SUNXI_UBI
	default y if CMD_SUNXI_UBI
	select LZO
	select GZIP
	help
	  UBIFS is a file system for flash devices which works on top of UBI.

config CMD_SUNXI_BOOTRV
	bool "enable bootrv"
	default y
	help
		enable sunxi bootrv

config CMD_SUNXI_BOOTRTOS
	bool "enable boot rtos"
	default y
	help
		enable sunxi boot rtos

config CMD_SUNXI_AMP
	bool "enable arm amp"
	default n
	help
		enable sunxi arm amp

config CMD_SUNXI_SOUND
	bool "sunxi sound test"
	default n
	help
	  Activate this option to test sunxi sound.

config CMD_SUNXI_SPRITE
	bool "sprite test"
	help
	  Activate this option to test sunxi sprite.

config CMD_SUNXI_PCIE_EP
	bool "sunxi pcie ep test"
	default n
	help
	  Activate this option to test sunxi pcie ep.
endmenu
```

## bsp/configs/sun55iw6p1_defconfig
```kconfig
CONFIG_ARM=y
CONFIG_ARM_SMCCC=y
CONFIG_ARCH_SUNXI=y
CONFIG_TEXT_BASE=0x4A000000
CONFIG_SYS_MALLOC_LEN=0x2000000
CONFIG_HAS_CUSTOM_SYS_INIT_SP_ADDR=y
CONFIG_CUSTOM_SYS_INIT_SP_ADDR=0x48000
CONFIG_DEFAULT_DEVICE_TREE="uboot-board"
CONFIG_SUNXI_SECURE_BOOT=y
CONFIG_MACH_SUN55IW6=y
# CONFIG_VIDEO_SUNXI is not set
CONFIG_SUNXI_PRIVATE_STORAGE=y
CONFIG_SUNXI_KEYBOX=y
CONFIG_SUNXI_EXTERN_SECURE_MM_LAYOUT=y
CONFIG_SUNXI_BOOT_PARAM=y
CONFIG_SUNXI_FDT_ADDR=0x42000000
CONFIG_SUNXI_SERIAL=y
CONFIG_SUNXI_FPGA_PLATFORM=y
CONFIG_SYS_CUSTOM_LDSCRIPT=y
CONFIG_SYS_LDSCRIPT="bsp/arch/arm/mach-sunxi/u-boot.lds"
CONFIG_ANDROID_BOOT_IMAGE=y
CONFIG_LOGLEVEL=6
CONFIG_BOARD_EARLY_INIT_F=y
CONFIG_SYS_MAXARGS=64
CONFIG_SYS_BOOTM_LEN=0x2000000
CONFIG_CMD_GPIO=y
CONFIG_CMD_PWM=y
CONFIG_CMD_MMC_SWRITE=y
CONFIG_CMD_LOG=y
# CONFIG_ENV_IS_IN_FAT is not set
# CONFIG_NET is not set
CONFIG_CLK_CCF=y
CONFIG_CLK_COMPOSITE_CCF=y
# CONFIG_CLK_SUNXI is not set
CONFIG_DM_HASH=y
CONFIG_DM_MOD_EXP=y
CONFIG_DMA=y
CONFIG_DMA_CHANNELS=y
CONFIG_MISC=y
# CONFIG_MMC_SUNXI is not set
CONFIG_DM_PMIC=y
CONFIG_PMIC_AXP=y
CONFIG_DM_REGULATOR=y
CONFIG_REGULATOR_AXP=y
CONFIG_DM_PWM=y
# CONFIG_WDT_SUNXI is not set
CONFIG_RSA=y
# CONFIG_TOOLS_LIBCRYPTO is not set
CONFIG_AW_GPIO=y
CONFIG_AW_DMA=y
CONFIG_AW_PWM=y
CONFIG_AW_CE_DRIVER=y
CONFIG_SUNXI_CE_23=y
CONFIG_AW_EFUSE=y
CONFIG_CMD_SUNXI_CLK=y
CONFIG_CMD_SUNXI_PRIVATE_STORAGE=y
CONFIG_CMD_SUNXI_EFUSE=y
CONFIG_CMD_SUNXI_DMA=y
```

## bsp/configs/sun55iw6p1_mr536_defconfig
```kconfig
CONFIG_ARM=y
CONFIG_ARM_SMCCC=y
CONFIG_ARCH_SUNXI=y
CONFIG_TEXT_BASE=0x4A000000
CONFIG_SYS_MALLOC_LEN=0x2000000
CONFIG_HAS_CUSTOM_SYS_INIT_SP_ADDR=y
CONFIG_CUSTOM_SYS_INIT_SP_ADDR=0x48000
CONFIG_ENV_SIZE=0x20000
CONFIG_DEFAULT_DEVICE_TREE="uboot-board"
CONFIG_SUNXI_SECURE_BOOT=y
CONFIG_MACH_SUN55IW6=y
# CONFIG_VIDEO_SUNXI is not set
CONFIG_SUNXI_KEYBOX=y
CONFIG_SUNXI_EXTERN_SECURE_MM_LAYOUT=y
CONFIG_SUNXI_BOOT_PARAM=y
CONFIG_SUNXI_SERIAL=y
CONFIG_SUNXI_MAC=y
CONFIG_SUNXI_USER_KEY=y
CONFIG_SUNXI_VERIFY_RISCV=y
CONFIG_SUNXI_IMAGE_HEADER=y
CONFIG_SUNXI_SPRITE=y
CONFIG_SUNXI_BOOT_ENV_INLINE=y
CONFIG_SUNXI_BOOT_ENV_STRING="preboot=sunxi_get_kern_env;sunxi_preboot\n bootcmd=run boot_riscv sunxi_pre_cmd boot_normal\n sunxi_pre_cmd=${sunxicmd};sunxi_update\n sunxicmd=run setargs_nand\n boot_normal=sunxi_flash read 0x4007f800 ${boot_partition};bootm 0x4007f800 ${sunxi_ramd_addr} ${sunxi_fdt_addr}\n boot_riscv=bootrv 46000000 200000 0 ${riscv_partition} ${riscv-r_partition}\n boot_recovery=\n boot_fastboot=fastboot\n altbootcmd=sunxi_switch_system\n"
CONFIG_SUNXI_ANDROID_OVERLAY=y
# CONFIG_DISTRO_DEFAULTS is not set
CONFIG_ENV_VARS_UBOOT_CONFIG=y
CONFIG_SYS_CUSTOM_LDSCRIPT=y
CONFIG_SYS_LDSCRIPT="bsp/arch/arm/mach-sunxi/u-boot.lds"
CONFIG_ANDROID_BOOT_IMAGE=y
# CONFIG_BOOTSTD_BOOTCOMMAND is not set
CONFIG_SUPPORT_RAW_INITRD=y
CONFIG_USE_BOOTCOMMAND=y
CONFIG_BOOTCOMMAND="run bootcmd"
CONFIG_LOGLEVEL=6
# CONFIG_CONSOLE_MUX is not set
CONFIG_SYS_STDIO_DEREGISTER=y
# CONFIG_SYS_DEVICE_NULLDEV is not set
# CONFIG_LOG_CONSOLE is not set
CONFIG_BOARD_EARLY_INIT_F=y
CONFIG_HUSH_PARSER=y
# CONFIG_CMDLINE_EDITING is not set
# CONFIG_AUTO_COMPLETE is not set
CONFIG_SYS_MAXARGS=64
# CONFIG_CMD_BOOTD is not set
# CONFIG_CMD_BOOTFLOW is not set
# CONFIG_BOOTM_NETBSD is not set
# CONFIG_BOOTM_PLAN9 is not set
# CONFIG_BOOTM_RTEMS is not set
# CONFIG_BOOTM_VXWORKS is not set
CONFIG_SYS_BOOTM_LEN=0x2000000
# CONFIG_CMD_BOOTEFI is not set
# CONFIG_CMD_ELF is not set
# CONFIG_CMD_GO is not set
# CONFIG_CMD_IMI is not set
# CONFIG_CMD_XIMG is not set
# CONFIG_CMD_EXPORTENV is not set
# CONFIG_CMD_IMPORTENV is not set
# CONFIG_CMD_EDITENV is not set
# CONFIG_CMD_CRC32 is not set
# CONFIG_CMD_MEMORY is not set
CONFIG_CMD_GPIO=y
CONFIG_CMD_PWM=y
# CONFIG_CMD_LOADB is not set
# CONFIG_CMD_LOADS is not set
CONFIG_CMD_MMC_SWRITE=y
CONFIG_CMD_PART=y
# CONFIG_CMD_ECHO is not set
# CONFIG_CMD_ITEST is not set
# CONFIG_CMD_SOURCE is not set
# CONFIG_CMD_SETEXPR is not set
# CONFIG_CMD_BLOCK_CACHE is not set
# CONFIG_CMD_CLS is not set
# CONFIG_CMD_EFICONFIG is not set
# CONFIG_CMD_SLEEP is not set
# CONFIG_CMD_VIDCONSOLE is not set
# CONFIG_CMD_CYCLIC is not set
CONFIG_CMD_LOG=y
CONFIG_ISO_PARTITION=y
# CONFIG_ENV_IS_IN_FAT is not set
# CONFIG_NET is not set
CONFIG_CLK_CCF=y
CONFIG_CLK_COMPOSITE_CCF=y
# CONFIG_CLK_SUNXI is not set
CONFIG_DM_HASH=y
CONFIG_DM_MOD_EXP=y
CONFIG_DMA=y
CONFIG_DMA_CHANNELS=y
CONFIG_MMC_HS400_SUPPORT=y
# CONFIG_MMC_SUNXI is not set
CONFIG_PINCONF=y
CONFIG_DM_PMIC=y
CONFIG_PMIC_AXP=y
CONFIG_REGULATOR_AXP=y
CONFIG_DM_PWM=y
CONFIG_BAUDRATE=1500000
CONFIG_SOUND=y
CONFIG_USB=y
# CONFIG_USB_GADGET is not set
# CONFIG_VIDEO_LOGO is not set
# CONFIG_VIDEO_BPP8 is not set
# CONFIG_VIDEO_BPP16 is not set
CONFIG_OSD=y
# CONFIG_WDT_SUNXI is not set
CONFIG_RSA=y
# CONFIG_TOOLS_LIBCRYPTO is not set
CONFIG_AW_PINCTRL_V3=y
CONFIG_AW_GPIO=y
CONFIG_AW_GPIO_V3=y
CONFIG_AW_DMA=y
CONFIG_AW_TWI=y
CONFIG_AW_PWM=y
CONFIG_AW_USB=y
CONFIG_AW_BURN=y
CONFIG_AW_DRM=y
CONFIG_AW_DRM_LVDS=y
CONFIG_AW_DRM_RGB=y
CONFIG_AW_DRM_DSI=y
# CONFIG_AW_DRM_HDMI_TX is not set
# CONFIG_AW_DRM_EINK200 is not set
CONFIG_AW_DRM_PANEL=y
CONFIG_PANEL_DSI_GENERAL=y
CONFIG_PANEL_LVDS_GENERAL=y
CONFIG_PANEL_RGB_GENERAL=y
CONFIG_AW_DRM_PHY=y
CONFIG_AW_CE_DRIVER=y
CONFIG_SUNXI_CE_23=y
CONFIG_AW_EFUSE=y
CONFIG_SUNXI_ARISC_EXIST=y
CONFIG_ARISC_DEASSERT_BEFORE_KERNEL=y
CONFIG_BOOT_RISCV=y
CONFIG_RISCV_UPDATA_IRQ_TAB=y
CONFIG_SOUND_SUNXI_SUN55IW6_CODEC=y
CONFIG_AW_REMOTEPROC=y
CONFIG_AW_RPROC_RSC_HELPER=y
CONFIG_AW_RPROC_USER_RESOURCE=y
CONFIG_CMD_SUNXI_TIMER=y
CONFIG_CMD_SUNXI_CLK=y
CONFIG_CMD_SUNXI_PRIVATE_STORAGE=y
CONFIG_CMD_SUNXI_BURN=y
CONFIG_CMD_SUNXI_EFUSE=y
CONFIG_CMD_SUNXI_AUTO_FEL=y
CONFIG_CMD_SUNXI_DMA=y
CONFIG_SUNXI_REDUNDAND_ENVIRONMENT=y
CONFIG_CRYPTO=y
```
